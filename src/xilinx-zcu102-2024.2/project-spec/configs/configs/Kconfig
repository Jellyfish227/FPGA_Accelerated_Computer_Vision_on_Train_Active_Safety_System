## src/xilinx-zcu102-2024.2/project-spec/configs/configs/Kconfig
```kconfig
mainmenu "PetaLinux System Configuration"
config SUBSYSTEM_TYPE_LINUX
        bool
        default y
        select SYSTEM_ZYNQMP

config SYSTEM_ZYNQMP
        bool "ZYNQMP Configuration"
        help
          ZYNQMP Configuration for petalinux project.
          All these config options will be in /home/jellyfish/Documents/FPGA_Accelerated_Computer_Vision_on_Train_Active_Safety_System/src/xilinx-zcu102-2024.2/project-spec/configs/config

config SUBSYSTEM_VARIANT_ZYNQMPEG
        bool
        default y
        help

config SUBSYSTEM_SDT_FLOW
        bool
        default y
        help

config SUBSYSTEM_DISTRO_PETALINUX
        bool
        default y
        help

source /home/jellyfish/Documents/FPGA_Accelerated_Computer_Vision_on_Train_Active_Safety_System/src/xilinx-zcu102-2024.2/project-spec/configs/configs/Kconfig.main
```

## src/xilinx-zcu102-2024.2/project-spec/configs/rootfsconfigs/Kconfig.user
```kconfig
menu "user packages " 
config cmake  
	 bool "cmake"
	 help
	
config dnf  
	 bool "dnf"
	 help
	
config gpio-demo  
	 bool "gpio-demo"
	 help
	
config nfs-utils  
	 bool "nfs-utils"
	 help
	
config opencl-clhpp-dev  
	 bool "opencl-clhpp-dev"
	 help
	
config opencl-headers-dev  
	 bool "opencl-headers-dev"
	 help
	
config packagegroup-petalinux-gstreamer  
	 bool "packagegroup-petalinux-gstreamer"
	 help
	
config packagegroup-petalinux-matchbox  
	 bool "packagegroup-petalinux-matchbox"
	 help
	
config packagegroup-petalinux-opencv  
	 bool "packagegroup-petalinux-opencv"
	 help
	
config packagegroup-petalinux-opencv-dev  
	 bool "packagegroup-petalinux-opencv-dev"
	 help
	
config packagegroup-petalinux-self-hosted  
	 bool "packagegroup-petalinux-self-hosted"
	 help
	
config packagegroup-petalinux-v4lutils  
	 bool "packagegroup-petalinux-v4lutils"
	 help
	
config packagegroup-petalinux-x11  
	 bool "packagegroup-petalinux-x11"
	 help
	
config peekpoke  
	 bool "peekpoke"
	 help
	
config resize-part  
	 bool "resize-part"
	 help
	
config vitis-ai-library  
	 bool "vitis-ai-library"
	 help
	
config vitis-ai-library-dbg  
	 bool "vitis-ai-library-dbg"
	 help
	
config vitis-ai-library-dev  
	 bool "vitis-ai-library-dev"
	 help
	
endmenu
```
